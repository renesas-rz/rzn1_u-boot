## arch/arm/cpu/armv7/rzn1/Kconfig
```kconfig
if ARCH_RZN1

config RZN1D
	bool
	default y

config RZN1S
	bool

choice
	prompt "RZN1 board select"
	optional

config TARGET_RENESAS_RZN1D400_DB
	bool "Renesas rzn1d400-db"
	select SUPPORT_SPL

config TARGET_RENESAS_RZN1S324_DB
	bool "Renesas rzn1s324-db"
	select SUPPORT_SPL

config TARGET_RENESAS_RZN1S_IO_LINK
	bool "Renesas rzn1s-io-link"
	select SUPPORT_SPL

config TARGET_RENESAS_RZN1L_DB
	bool "Renesas rzn1l-db"

endchoice

config SYS_SOC
	default "rzn1"

source "board/renesas/rzn1d400-db/Kconfig"
source "board/renesas/rzn1s324-db/Kconfig"
source "board/renesas/rzn1s-io-link/Kconfig"
source "board/renesas/rzn1l-db/Kconfig"

endif
```

## board/renesas/rzn1d400-db/Kconfig
```kconfig
if TARGET_RENESAS_RZN1D400_DB

config SYS_BOARD
	default "rzn1d400-db"

config SYS_VENDOR
	default "renesas"

config SYS_SOC
	default "rzn1"

config SYS_CONFIG_NAME
	default "rzn1d400-db"

endif
```

## board/renesas/rzn1l-db/Kconfig
```kconfig
if TARGET_RENESAS_RZN1L_DB

config SYS_BOARD
	default "rzn1l-db"

config SYS_VENDOR
	default "renesas"

config SYS_SOC
	default "rzn1"

config SYS_CONFIG_NAME
	default "rzn1l-db"

endif
```

## board/renesas/rzn1s-io-link/Kconfig
```kconfig
if TARGET_RENESAS_RZN1S_IO_LINK

config SYS_BOARD
	default "rzn1s-io-link"

config SYS_VENDOR
	default "renesas"

config SYS_SOC
	default "rzn1"

config SYS_CONFIG_NAME
	default "rzn1s-io-link"

endif
```

## board/renesas/rzn1s324-db/Kconfig
```kconfig
if TARGET_RENESAS_RZN1S324_DB

config SYS_BOARD
	default "rzn1s324-db"

config SYS_VENDOR
	default "renesas"

config SYS_SOC
	default "rzn1"

config SYS_CONFIG_NAME
	default "rzn1s324-db"

endif
```

## configs/rzn1l-db_defconfig
```kconfig
CONFIG_ARM=y
CONFIG_ARCH_RZN1L=y
CONFIG_TARGET_RENESAS_RZN1L_DB=y
CONFIG_HUSH_PARSER=y
CONFIG_BOOTDELAY=1

CONFIG_DEBUG_UART=y
CONFIG_DEBUG_UART_NS16550=y
CONFIG_DEBUG_UART_BASE=0x40060000
CONFIG_DEBUG_UART_CLOCK=20000000
CONFIG_DEBUG_UART_SHIFT=2

# CONFIG_EFI_LOADER is not set

# CONFIG_CMD_FLASH is not set
# CONFIG_CMD_IMLS is not set
# CONFIG_CMD_LOADB is not set
# CONFIG_CMD_LOADS is not set
# CONFIG_CMD_FPGA is not set
# CONFIG_CMD_XIMG is not set
# CONFIG_CMD_CONSOLE is not set
# CONFIG_CMD_DM is not set
# CONFIG_CMD_EDITENV is not set
# CONFIG_CMD_CACHE is not set
CONFIG_CMD_TIMER=y
# CONFIG_CMD_ITEST is not set
# CONFIG_CMD_SETEXPR is not set
# CONFIG_CMD_MEMTEST is not set

CONFIG_DEFAULT_DEVICE_TREE="rzn1l-db"
# CONFIG_DISPLAY_CPUINFO is not set

########## USBF/DFU ##########
CONFIG_USB=y
CONFIG_USB_GADGET=y
CONFIG_USB_GADGET_DOWNLOAD=y
CONFIG_G_DNL_MANUFACTURER="Renesas Electronics"
CONFIG_G_DNL_VENDOR_NUM=0x045b
CONFIG_G_DNL_PRODUCT_NUM=0x0239
CONFIG_DFU_SF=y
# CONFIG_DFU_NAND is not set
CONFIG_DFU_RAM=y
CONFIG_CMD_DFU=y
CONFIG_CMD_DFU_EXT=y

########## I2C ##########
CONFIG_CMD_I2C=y

########## SF ##########
CONFIG_SPI_FLASH=y
CONFIG_SPI_FLASH_BAR=y
CONFIG_SPI_FLASH_MACRONIX=y
# CONFIG_SPI_FLASH_USE_4K_SECTORS is not set

########## ETH ##########
CONFIG_ETH_DESIGNWARE=y
CONFIG_NETDEVICES=y
CONFIG_NET=y
CONFIG_CMD_MII=y
CONFIG_CMD_PING=y
# CONFIG_CMD_NFS is not set

################################# SPL ##########################################
# CONFIG_SPL is not set
```

## configs/rzn1s-io-link_defconfig
```kconfig
CONFIG_ARM=y
CONFIG_ARCH_RZN1S=y
CONFIG_TARGET_RENESAS_RZN1S_IO_LINK=y
CONFIG_HUSH_PARSER=y
CONFIG_BOOTDELAY=1

CONFIG_DEBUG_UART=y
CONFIG_DEBUG_UART_NS16550=y
CONFIG_DEBUG_UART_BASE=0x40060000
CONFIG_DEBUG_UART_CLOCK=20000000
CONFIG_DEBUG_UART_SHIFT=2

# CONFIG_EFI_LOADER is not set

# CONFIG_CMD_FLASH is not set
# CONFIG_CMD_IMLS is not set
# CONFIG_CMD_LOADB is not set
# CONFIG_CMD_LOADS is not set
# CONFIG_CMD_XIMG is not set
# CONFIG_CMD_CONSOLE is not set
# CONFIG_CMD_DM is not set
# CONFIG_CMD_EDITENV is not set
CONFIG_CMD_BOOTZ=y
CONFIG_CMD_CACHE=y
CONFIG_CMD_TIMER=y
# CONFIG_CMD_ITEST is not set
# CONFIG_CMD_SETEXPR is not set

CONFIG_DEFAULT_DEVICE_TREE="rzn1s-io-link"
# CONFIG_DISPLAY_CPUINFO is not set

########## GPIO ##########
CONFIG_DM_PCA953X=y
# CONFIG_CMD_GPIO is not set

CONFIG_LED=y
CONFIG_LED_GPIO=y

########## FPGA ##########
CONFIG_CMD_FPGA=y

########## USBF/DFU ##########
CONFIG_USB=y
CONFIG_USB_GADGET=y
CONFIG_USB_GADGET_DOWNLOAD=y
CONFIG_G_DNL_MANUFACTURER="Renesas Electronics"
CONFIG_G_DNL_VENDOR_NUM=0x045b
CONFIG_G_DNL_PRODUCT_NUM=0x0239
CONFIG_DFU_SF=y
# CONFIG_DFU_NAND is not set
CONFIG_DFU_RAM=y
CONFIG_CMD_DFU=y
CONFIG_CMD_DFU_EXT=y

########## I2C ##########
# CONFIG_CMD_I2C is not set

########## SF ##########
CONFIG_SPI_FLASH=y
CONFIG_SPI_FLASH_BAR=y
CONFIG_SPI_FLASH_MACRONIX=y
# CONFIG_SPI_FLASH_USE_4K_SECTORS is not set

########## ETH ##########
CONFIG_ETH_DESIGNWARE=y
CONFIG_NETDEVICES=y
CONFIG_NET=y
CONFIG_CMD_MII=y
CONFIG_CMD_PING=y
# CONFIG_CMD_NFS is not set

########## SDHC ##########
CONFIG_ARASAN_SDHCI=y
# CONFIG_BLK is not set
CONFIG_MMC=y
# CONFIG_DM_MMC_OPS is not set
CONFIG_MMC_SDHCI=y
CONFIG_MMC_SDHCI_SDMA=y
CONFIG_CMD_MMC=y
CONFIG_CMD_FAT=y
CONFIG_CMD_EXT4=y


################################# SPL ##########################################
CONFIG_SPL=y
# CONFIG_SPL_DM_DEVICE_REMOVE is not set
CONFIG_SPL_SERIAL_SUPPORT=y
CONFIG_SPL_I2C_SUPPORT=y
CONFIG_SPL_GPIO_SUPPORT=y
CONFIG_SPL_OF_TRANSLATE=y
CONFIG_OF_SPL_REMOVE_PROPS="pinctrl-0 pinctrl-names clocks clock-names interrupt-parent interrupts"
CONFIG_SPL_DM_SEQ_ALIAS=y
CONFIG_SPL_USE_ARCH_MEMSET=y
CONFIG_SPL_USE_ARCH_MEMCPY=y
CONFIG_SPL_OS_BOOT=y
CONFIG_SPL_MULTIIMAGE=y

########## SF ##########
CONFIG_SPL_SPI_FLASH_SUPPORT=y
CONFIG_SPL_SPI_SUPPORT=y

# CONFIG_SPL_NAND_SUPPORT is not set
# CONFIG_SPL_NAND_DRIVERS is not set
# CONFIG_SPL_NAND_ONFI is not set
```
