/*
 * Device Tree Source for the RZ/N1S devices.
 *
 * Copyright (C) 2016 Renesas Electronics Europe Ltd
 *
 * This file is licensed under the terms of the GNU General Public License
 * version 2.  This program is licensed "as is" without any warranty of any
 * kind, whether express or implied.
 */

#include "rzn1.dtsi"

/ {
	compatible = "renesas,rzn1s";

	aliases {
		spi1 = &qspi1;
	};

	bus {
		qspi1: spi@4000e000 {
			compatible = "renesas,rzn1-qspi";
			#address-cells = <1>;
			#size-cells = <0>;
			reg = <0x4000e000 0x1000
				0xa0000000 0x10000000>;
			reg-names = "qspi", "qspi-mapping";
			interrupts = <GIC_SPI 65 IRQ_TYPE_LEVEL_HIGH>;
			clocks = <&hclk_qspi1>, <&clk_qspi1>;
			clock-names = "flexway", "pclk";
			status = "disabled";
		};
	};
};
